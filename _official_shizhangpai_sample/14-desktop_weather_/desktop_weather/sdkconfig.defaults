## _official_shizhangpai_sample/14-desktop_weather_/desktop_weather/sdkconfig.defaults
```kconfig
CONFIG_EXAMPLE_WIFI_SSID="CMCC-2D2K"
CONFIG_EXAMPLE_WIFI_PASSWORD="sedf4693"
CONFIG_LV_USE_USER_DATA=y
CONFIG_LV_COLOR_16_SWAP=y
CONFIG_LV_COLOR_DEPTH_16=y
```

## 例程代码（IDF）_立创官方案例/09-lvgl_demo/lvgl_demo/main/Kconfig.projbuild
```kconfig
menu "Example Configuration"

    choice EXAMPLE_LCD_CONTROLLER
        prompt "LCD controller model"
        default EXAMPLE_LCD_CONTROLLER_ILI9341
        help
            Select LCD controller model

        config EXAMPLE_LCD_CONTROLLER_ILI9341
            bool "ILI9341"

        config EXAMPLE_LCD_CONTROLLER_GC9A01
            bool "GC9A01"
        
        config EXAMPLE_LCD_CONTROLLER_ST7789
            bool "ST7789"
    endchoice

    config EXAMPLE_LCD_TOUCH_ENABLED
        bool "Enable LCD touch"
        default n
        help
            Enable this option if you wish to use display touch. You can select from touch controllers.

    choice EXAMPLE_LCD_TOUCH_CONTROLLER
        prompt "LCD touch controller model"
        depends on EXAMPLE_LCD_TOUCH_ENABLED
        default EXAMPLE_LCD_TOUCH_CONTROLLER_STMPE610
        help
            Select LCD touch controller model

        config EXAMPLE_LCD_TOUCH_CONTROLLER_STMPE610
            bool "STMPE610"
        
        config EXAMPLE_LCD_TOUCH_CONTROLLER_FT6336
            bool "FT6336"
    endchoice

endmenu
```
